## build/Kconfig/arch/Kconfig
```kconfig
# Load Zephyr Arch Kconfig descriptions.
osource "D:/work/ncs/v3.3.0-rc2/zephyr/arch/rx/Kconfig"
osource "D:/work/ncs/v3.3.0-rc2/zephyr/arch/x86/Kconfig"
osource "D:/work/ncs/v3.3.0-rc2/zephyr/arch/xtensa/Kconfig"
osource "D:/work/ncs/v3.3.0-rc2/zephyr/arch/sparc/Kconfig"
osource "D:/work/ncs/v3.3.0-rc2/zephyr/arch/riscv/Kconfig"
osource "D:/work/ncs/v3.3.0-rc2/zephyr/arch/posix/Kconfig"
osource "D:/work/ncs/v3.3.0-rc2/zephyr/arch/mips/Kconfig"
osource "D:/work/ncs/v3.3.0-rc2/zephyr/arch/arm64/Kconfig"
osource "D:/work/ncs/v3.3.0-rc2/zephyr/arch/arm/Kconfig"
osource "D:/work/ncs/v3.3.0-rc2/zephyr/arch/arc/Kconfig"
```

## build/Kconfig/boards/Kconfig.nrf54l15dk.tmp
```kconfig
# Load board Kconfig descriptions.
osource "D:/work/ncs/v3.3.0-rc2/zephyr/boards/nordic/nrf54l15dk/Kconfig.nrf54l15dk"
```

## build/i2s_minimal/Kconfig/boards/Kconfig.defconfig
```kconfig
# Load Zephyr board defconfig descriptions.
osource "D:/work/ncs/v3.3.0-rc2/zephyr/boards/nordic/nrf54l15dk/Kconfig.defconfig"
```
